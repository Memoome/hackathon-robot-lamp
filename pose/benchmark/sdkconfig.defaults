## pose/benchmark/sdkconfig.defaults
```kconfig
CONFIG_IDF_TARGET="esp32s3"
CONFIG_ESPTOOLPY_FLASHMODE_QIO=y
CONFIG_ESPTOOLPY_FLASHSIZE_16MB=y
CONFIG_PARTITION_TABLE_CUSTOM=y
CONFIG_PARTITION_TABLE_CUSTOM_FILENAME="partitions.csv"
CONFIG_PARTITION_TABLE_OFFSET=0x10000
CONFIG_COMPILER_OPTIMIZATION_PERF=y
CONFIG_SPIRAM=y
CONFIG_SPIRAM_MODE_OCT=y
CONFIG_SPIRAM_SPEED_80M=y
CONFIG_SPIRAM_USE_MALLOC=y
CONFIG_ESP_DEFAULT_CPU_FREQ_MHZ_240=y
CONFIG_ESP32S3_INSTRUCTION_CACHE_32KB=y
CONFIG_ESP32S3_DATA_CACHE_64KB=y
CONFIG_ESP32S3_DATA_CACHE_LINE_64B=y
CONFIG_ESP_MAIN_TASK_STACK_SIZE=8192
CONFIG_ESP_TASK_WDT_TIMEOUT_S=40
CONFIG_COCO_POSE_MODEL_IN_FLASH_PARTITION=y
CONFIG_FLASH_COCO_POSE_YOLO11N_POSE_S8_V1=y
# CONFIG_FLASH_COCO_POSE_YOLO11N_POSE_S8_V2 is not set
CONFIG_COCO_POSE_YOLO11N_POSE_S8_V1=y
```

## pose/live/firmware/sdkconfig.defaults
```kconfig
CONFIG_IDF_TARGET="esp32s3"
CONFIG_ESPTOOLPY_FLASHMODE_QIO=y
CONFIG_ESPTOOLPY_FLASHSIZE_16MB=y
CONFIG_PARTITION_TABLE_CUSTOM=y
CONFIG_PARTITION_TABLE_CUSTOM_FILENAME="partitions.csv"
CONFIG_PARTITION_TABLE_OFFSET=0x10000
CONFIG_COMPILER_OPTIMIZATION_PERF=y
CONFIG_SPIRAM=y
CONFIG_SPIRAM_MODE_OCT=y
CONFIG_SPIRAM_SPEED_80M=y
CONFIG_SPIRAM_USE_MALLOC=y
CONFIG_ESP_DEFAULT_CPU_FREQ_MHZ_240=y
CONFIG_ESP32S3_INSTRUCTION_CACHE_32KB=y
CONFIG_ESP32S3_DATA_CACHE_64KB=y
CONFIG_ESP32S3_DATA_CACHE_LINE_64B=y
CONFIG_ESP_MAIN_TASK_STACK_SIZE=8192
CONFIG_ESP_TASK_WDT_TIMEOUT_S=40

CONFIG_CAMERA_BF3901=y
CONFIG_CAMERA_BF3901_AUTO_DETECT_SPI_INTERFACE_SENSOR=y
# CONFIG_CAMERA_BF3901_SPI_RGB565_240X320_15FPS is not set
# CONFIG_CAMERA_BF3901_SPI_YUV422_120X160_5FPS is not set
# CONFIG_CAMERA_BF3901_SPI_YUV422_240X320_12FPS is not set
# CONFIG_CAMERA_BF3901_SPI_YUV422_120X160_10FPS is not set
# CONFIG_CAMERA_BF3901_SPI_YUV422_240X240_10FPS is not set
CONFIG_CAMERA_BF3901_SPI_YUV422_240X320_15FPS=y
# CONFIG_CAMERA_BF3901_SPI2_YUV422_240X320_18FPS is not set
# CONFIG_CAMERA_BF3901_SPI2_YUV422_240X320_20FPS is not set
# CONFIG_CAMERA_BF3901_SPI_YUV422_YUYV_120X160_5FPS is not set
# CONFIG_CAMERA_BF3901_SPI_YUV422_YUYV_240X320_12FPS is not set
# CONFIG_CAMERA_BF3901_SPI_YUV422_YUYV_120X160_10FPS is not set
# CONFIG_CAMERA_BF3901_SPI_YUV422_YUYV_240X240_10FPS is not set
# CONFIG_CAMERA_BF3901_SPI_YUV422_YUYV_240X320_15FPS is not set
# CONFIG_CAMERA_BF3901_SPI2_YUV422_YUYV_240X320_18FPS is not set
# CONFIG_CAMERA_BF3901_SPI2_YUV422_YUYV_240X320_20FPS is not set
CONFIG_CAMERA_BF3901_SPI_DEFAULT_FMT_YUV422_240X320_15FPS=y
CONFIG_CAMERA_BF3901_SPI_IF_FORMAT_INDEX_DEFAULT=1
# CONFIG_CAMERA_SP0A39 is not set
CONFIG_CAMERA_SENSOR_XCLK_INPUT_24M=y
CONFIG_CAMERA_XCLK_USE_LEDC=y
CONFIG_ESP_SCCB_TRANS_TIMEOUT_DEFAULT=500
CONFIG_ESP_VIDEO_ENABLE_DATA_PREPROCESSING=y
CONFIG_ESP_VIDEO_CHECK_PARAMETERS=y
CONFIG_ESP_VIDEO_ENABLE_SPI_VIDEO_DEVICE=y
# CONFIG_ESP_VIDEO_ENABLE_THE_SECOND_SPI_VIDEO_DEVICE is not set
# CONFIG_ESP_VIDEO_ENABLE_USB_UVC_VIDEO_DEVICE is not set

# CONFIG_ESP_CONSOLE_UART_DEFAULT is not set
CONFIG_ESP_CONSOLE_UART_BAUDRATE=921600

CONFIG_COCO_POSE_MODEL_IN_FLASH_PARTITION=y
CONFIG_FLASH_COCO_POSE_YOLO11N_POSE_S8_V1=y
# CONFIG_FLASH_COCO_POSE_YOLO11N_POSE_S8_V2 is not set
CONFIG_COCO_POSE_YOLO11N_POSE_S8_V1=y

CONFIG_PEDESTRIAN_DETECT_MODEL_IN_FLASH_RODATA=y
CONFIG_FLASH_PEDESTRIAN_DETECT_PICO_S8_V1=y
CONFIG_PEDESTRIAN_DETECT_PICO_S8_V1=y

CONFIG_ESP_CONSOLE_UART_CUSTOM=y
CONFIG_ESP_CONSOLE_UART_NUM=0
CONFIG_ESP_CONSOLE_UART_TX_GPIO=43
CONFIG_ESP_CONSOLE_UART_RX_GPIO=44
CONFIG_ESP_CONSOLE_UART_BAUDRATE=921600
```
